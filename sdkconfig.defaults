## sdkconfig.defaults
```kconfig
# ================================================================
# 目标芯片
# ================================================================
CONFIG_IDF_TARGET="esp32c6"

# ================================================================
# Matter / CHIP 核心配置
# ================================================================
CONFIG_ESP_MATTER_ENABLE_DATA_MODEL=y

# Matter 设备基本信息（可按需修改）
CONFIG_DEVICE_VENDOR_ID=0xFFF1          # 测试用 VID（非商业产品）
CONFIG_DEVICE_PRODUCT_ID=0x8000         # 自定义 PID

# ================================================================
# Wi-Fi（Matter 通过 BLE 配网，此处为备用直连配置）
# ================================================================
CONFIG_ESP_WIFI_SSID="YOUR_WIFI_SSID"
CONFIG_ESP_WIFI_PASSWORD="YOUR_WIFI_PASSWORD"

# ================================================================
# BLE（Matter 配网必须，ESP32-C6 原生支持）
# ================================================================
CONFIG_BT_ENABLED=y
CONFIG_BT_NIMBLE_ENABLED=y
CONFIG_BT_NIMBLE_MEM_ALLOC_MODE_EXTERNAL=y

# ================================================================
# 分区表（Matter 需要较大 NVS 和 OTA 分区）
# ================================================================
CONFIG_PARTITION_TABLE_CUSTOM=y
CONFIG_PARTITION_TABLE_CUSTOM_FILENAME="partitions.csv"
CONFIG_PARTITION_TABLE_OFFSET=0x8000

# ================================================================
# Flash & 内存
# ================================================================
CONFIG_ESPTOOLPY_FLASHSIZE_4MB=y
CONFIG_ESPTOOLPY_FLASHSIZE="4MB"
CONFIG_ESP32C6_SPIRAM_SUPPORT=n         # C6N4 无 PSRAM

# ================================================================
# FreeRTOS
# ================================================================
CONFIG_FREERTOS_HZ=1000
CONFIG_FREERTOS_UNICORE=n               # C6 是单核 RISC-V，设 n 即可

# ================================================================
# 日志
# ================================================================
CONFIG_LOG_DEFAULT_LEVEL_INFO=y
CONFIG_LOG_MAXIMUM_LEVEL_DEBUG=y
CONFIG_BOOTLOADER_LOG_LEVEL_WARN=y

# ================================================================
# 系统堆栈
# ================================================================
CONFIG_ESP_MAIN_TASK_STACK_SIZE=8192
CONFIG_ESP_SYSTEM_EVENT_TASK_STACK_SIZE=4096
CONFIG_CHIP_TASK_STACK_SIZE=8192

# ================================================================
# Matter Shell（调试用，生产可关闭）
# ================================================================
CONFIG_ENABLE_CHIP_SHELL=y

# ================================================================
# OTA（生产建议开启）
# ================================================================
CONFIG_ENABLE_OTA_REQUESTOR=n
```
